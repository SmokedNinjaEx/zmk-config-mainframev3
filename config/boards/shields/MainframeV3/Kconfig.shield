## config/boards/shields/MainframeV3/Kconfig.shield
```kconfig
config SHIELD_MAINFRAMEV3_LEFT
    def_bool $(shields_list_contains,MainframeV3_left)

config SHIELD_MAINFRAMEV3_RIGHT
    def_bool $(shields_list_contains,MainframeV3_right)
```

## config/boards/shields/mainframev3/Kconfig.defconfig
```kconfig
if SHIELD_MAINFRAMEV3_LEFT

config ZMK_KEYBOARD_NAME
    default "Mainframe v3"

config ZMK_SPLIT_ROLE_CENTRAL
    default y

endif

if SHIELD_MAINFRAMEV3_LEFT || SHIELD_MAINFRAMEV3_RIGHT

config ZMK_SPLIT
    default y

endif
```
