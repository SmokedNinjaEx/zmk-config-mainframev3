#include "MainframeV3.dtsi"

&kscan0 {
    diode-direction = "col2row";

    // top to bottom
    row-gpios
        = <&pro_micro 0 (GPIO_ACTIVE_HIGH | GPIO_PULL_DOWN)>  // COL 0 (NUM)
        , <&pro_micro 1 (GPIO_ACTIVE_HIGH | GPIO_PULL_DOWN)>  // COL 1 (UPPER)
        , <&pro_micro 2 (GPIO_ACTIVE_HIGH | GPIO_PULL_DOWN)>  // COL 2 (HOME)
        , <&pro_micro 3 (GPIO_ACTIVE_HIGH | GPIO_PULL_DOWN)>  // COL 3 (LOWER)
        , <&pro_micro 4 (GPIO_ACTIVE_HIGH | GPIO_PULL_DOWN)>  // COL 4 (THUMB + ROT)
        ;

    // left to right    
    col-gpios
        = <&pro_micro 10 GPIO_ACTIVE_HIGH>  // ROW 0 (outer)
        , <&pro_micro 9 GPIO_ACTIVE_HIGH>  // ROW 1 (pinky)
        , <&pro_micro 8 GPIO_ACTIVE_HIGH>  // ROW 2 (ring)
        , <&pro_micro 7 GPIO_ACTIVE_HIGH>  // ROW 3 (middle)
        , <&pro_micro 6 GPIO_ACTIVE_HIGH>  // ROW 4 (index)
        , <&pro_micro 5 GPIO_ACTIVE_HIGH>  // ROW 5 (inner)
        ;
};

nice_view_spi: &spi0 {
    compatible = "nordic,nrf-spim";
    pinctrl-0 = <&spi0_default>;
    pinctrl-1 = <&spi0_sleep>;
    pinctrl-names = "default", "sleep";
    cs-gpios = <&gpio1 7 GPIO_ACTIVE_HIGH>;
};
